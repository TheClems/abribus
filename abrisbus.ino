// THONAIN POUR ECRAN Oled : affiche du texte et une variable
#include <SPI.h>
#include <Wire.h>
#include <Adafruit_GFX.h>
#include <Adafruit_SSD1306.h>
#define SCREEN_WIDTH 128     // OLED display width, in pixels
#define SCREEN_HEIGHT 64     // OLED display height, in pixels
#define OLED_RESET -1        // Reset pin # (or -1 if sharing Arduino reset pin)
#define SCREEN_ADDRESS 0x3C  ///< See datasheet for Address; 0x3D for 128x64, 0x3C for 128x32
Adafruit_SSD1306 display(SCREEN_WIDTH, SCREEN_HEIGHT, &Wire, OLED_RESET);
//variable
int changement = 1;
int var = 0;
int min2 = 0;
int sec2 = 0;
String zero = "";
//Variable de temps, entrer le nombre de minutes et le nombre de seconde
int min = 2;
int sec = 31;




// Image de bus qui défile
const unsigned char Bus[] PROGMEM = {
  0x00, 0x00, 0x00, 0x00, 0x00, 0x00, 0x00, 0x00, 0x00, 0x00, 0x00, 0x00, 0x00, 0x00, 0x00, 0x00,
  0x00, 0x00, 0x00, 0x00, 0x00, 0x00, 0x00, 0x00, 0x00, 0x00, 0x00, 0x00, 0x00, 0x00, 0x00, 0x00,
  0x00, 0x00, 0x00, 0x00, 0x00, 0x00, 0x00, 0x00, 0x00, 0x00, 0x00, 0x00, 0x00, 0x00, 0x00, 0x00,
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  0x00, 0x00, 0x00, 0x00, 0x00, 0x00, 0x00, 0x00, 0x00, 0x00, 0x00, 0x00, 0x00, 0x00, 0x00, 0x00
};


void setup() {

  Serial.begin(9600);
  min2 = min;
  sec2 = sec;
  // SSD1306_SWITCHCAPVCC = generate display voltage from 3.3V internally
  if (!display.begin(SSD1306_SWITCHCAPVCC, SCREEN_ADDRESS)) {
    Serial.println(F("SSD1306 allocation failed"));
    for (;;)
      ;  // Don't proceed, loop forever
  }
  display.display();
  delay(2000);  // Pause for 2 seconds
}
void loop() {

  if (changement == 1) {

    timer();
  }
  if (changement == 0) {
    prochain();
  }
}

void timer() {

  if (sec > 0) {
    sec--;
    delay(1000);
  }
  if (sec == 0) {
    sec = 59;
    min--;
  }
  if (min == 0 & sec == 1) {

    delay(1000);
    changement = 0;
    void exit();
  }
  if (sec < 10) {
    zero = "0";
  } else {
    zero = "";
  }
  display.clearDisplay();
  display.setTextColor(WHITE);
  display.setTextSize(2);
  display.setCursor(15, 0);  // position du curseur colonne / ligne
  display.println("Prochain");
  display.setCursor(45, 21);  // position du curseur colonne / ligne
  display.println("Bus");
  display.setCursor(35, 42);  // position du curseur colonne / ligne
  display.println((String) "0" + min + ":" + zero + sec);
  display.display();
}


void prochain() {

  // arrivée du bus
  for (int i = 128; i > 0; i = i - 3) {
    display.clearDisplay();
    display.drawBitmap(i, 0, Bus, 128, 64, WHITE);
    display.display();
  }

  // bus en pause
  display.clearDisplay();
  //display.setTextColor(WHITE);
  display.drawBitmap(0, 0, Bus, 128, 64, WHITE);
  display.display();
  delay(5000);

  // départ du bus
  for (int i = 0; i > -128; i = i - 3) {
    display.clearDisplay();
    display.drawBitmap(i, 0, Bus, 128, 64, WHITE);
    display.display();
  }


  sec = sec2;
  min = min2;
  changement = 1;

  display.clearDisplay();
}
